/*!
 *  @file waveGen.cpp
 *
 *   Waveform Generator using MCP4728
 *
 *  T3.3 (C14 in CodeDocs/SCHEDULER_AND_HARDWARE_OFFLOAD.md): the stream is
 *  hardware-owned. What used to be a per-sample loop on core 1 (one Wire
 *  transaction per sample, ~50 us each, core 1 captured for the whole stream,
 *  no LED frames and no crossbar sends meanwhile) is now:
 *
 *    - an IMAGE in RAM: for every one of the N samples of a cycle the exact
 *      three IC_DATA_CMD entries the MCP4728 write used to put on the wire
 *      ([0x40 | ch<<1] [D11..D8] [D7..D0 | STOP]) - a 3-entry burst per
 *      sample, START and STOP generated by the I2C block itself, so every
 *      sample is its own short transaction exactly as before;
 *    - channel A: image -> I2C0 TX FIFO, DREQ = the FIFO, 3 entries per
 *      trigger, read address supplied per burst;
 *    - channel B2: an ADDRESS RING (one word per sample = the address of its
 *      3 entries, read with a hardware ring wrap - which is why N is a power
 *      of two: the ring's 4N bytes must be a power of two, the image's 6N
 *      cannot be) -> A's READ_ADDR_TRIG. One write = one sample burst;
 *    - channel B1: the PACING DIVIDER: D dummy transfers per pass, DREQ = a
 *      DMA pacing timer (clk_sys * X / Y), chained to B2, and B2 chains back
 *      to B1. So one sample every D timer ticks, forever, until the timer is
 *      set to 0. The divider is what reaches below the timer's ~2.3 kHz floor
 *      (0.0001 Hz needs a tick every 5000 s at N = 2).
 *
 *  Frequency = clk_sys * X / (Y * D * N), EXACT to the timer's fraction (the
 *  planner picks N as the largest power of two the bus can carry at that
 *  rate, then D and the best X/Y <= 65535 for the tick); the old model's
 *  "actual frequency" (a 4.67-bytes-per-sample estimate of what the CPU loop
 *  achieved) is gone with the loop. The trade: N is a power of two, so an
 *  unlucky frequency gets up to 2x fewer samples per cycle than the old
 *  arbitrary-N table - in exchange for the frequency being right.
 *
 *  Control (start / stop / re-plan on a setter) is done SYNCHRONOUSLY on
 *  the caller's core, and every caller is core 0 (the MicroPython API - the
 *  VM runs on core 0 - and the menus); I2C0's other users (INA219s, DAC
 *  setters, the OLED on this rev) are core 0 too and already skip while
 *  isRunning() - those gates are BUS gates and stay. Core 1's service() is
 *  a monitor: progress (ring laps), TX_ABRT (counted and cleared - the
 *  block flushes its FIFO on a NAK and holds it until cleared), and a wedge
 *  latch. isRunning() stays true across a setter-triggered restart so no
 *  bus user slips in during the teardown/rebuild.
 *
 *  Stop: the timer goes to 0 (no more ticks), B1/B2 are aborted, A is left
 *  to finish its in-flight burst (it only ever pushes whole 3-entry bursts,
 *  so the FIFO always ends on a STOP entry), then wait for the FIFO to drain
 *  and the bus to go idle, DMA_CR off. A wedged A (bus stuck mid-burst) is
 *  the one path that aborts A and pushes the sample's remaining entries by
 *  hand so the transaction ends with a STOP; then the block's own ABORT.
 *
 *  Sustained overrun is the one structural weakness: if the tick rate
 *  exceeded what the bus can carry, the FIFO would back up, A would stall
 *  mid-burst and B2's next READ_ADDR_TRIG would land on a busy A. The
 *  planner caps the tick at 85 % of the bus capacity computed from I2C0's
 *  actual SCL counts (40 bit-times per sample), so it cannot happen at any
 *  legal setting; the monitor's progress check is the backstop.
 *
 *  Fallback: if a DMA channel or timer cannot be claimed (or Wire is not
 *  I2C0), the legacy per-sample CPU loop below runs exactly as before, and
 *  X says so.
 */

#include "WaveGen.h"
#include "KickGap.h" // would-be watchdog kick from the LEGACY stream loop (T1.6 measure-only)
#include <math.h>
#include <new>  // For std::nothrow
#include "hardware/dma.h"
#include "hardware/i2c.h"
#include "hardware/clocks.h"
#include "hardware/structs/i2c.h"
#include "hardware/structs/dma.h"
#include "hardware/sync.h"

// The address ring: B2 reads it with a hardware ring wrap of 4N bytes, so it
// must sit at an address aligned to its own size; 4 KB alignment covers
// every N <= 1024. Static (BSS) - the heap cannot promise alignment.
static uint32_t __attribute__((aligned(4096))) s_addrRing[1024];

// Pacing-timer floor: clk_sys / 65535 = 2289 Hz at 150 MHz; plan ticks
// comfortably above it and let the divider do the rest.
#define WG_TICK_T_MIN_HZ   3000.0f
// Fraction of the computed bus capacity the planner will use.
#define WG_CAPACITY_MARGIN 0.85f
// I2C bit-times per 3-byte MCP4728 write: START + 4 x 9 bits + STOP + the
// block's hold/setup times, rounded up.
#define WG_BITS_PER_SAMPLE 40.0f
// IC_DATA_CMD bits
#define WG_DC_STOP I2C_IC_DATA_CMD_STOP_BITS

/*!
 *    @brief  Constructor
 */
WaveGen::WaveGen() :
    _channel(WAVEGEN_DAC0),
    _waveform(WAVEGEN_SINE),
    _frequency_hz(1000.0f),
    _amplitude_v(1.0f),
    _offset_v(0.0f),
    _running(false),
    _initialized(false),
    _use_fallback(true), // Start in fallback mode for stability
    _last_sample_time(0),
    _sample_interval_us(0),
    _sample_count(0),
    _waveform_table(nullptr),  // Dynamic allocation
    _table_size(64),  // Start with small table
    _table_index(0),
    _waveform_table_allocated(false),
    _buffer_size(0),
    _buffer_cycles(0),
    _params_changed(false),
    _successful_writes(0),
    _failed_writes(0),
    _last_stats_time(0),
    _actual_frequency(0.0f),
    _dmaAvailable(false),
    _dmaFallbackReason(0),
    _dmaStreaming(false),
    _dmaWedged(false),
    _chA(-1), _chB1(-1), _chB2(-1),
    _dmaTimer(-1),
    _image(nullptr),
    _imageAllocated(false),
    _lastRingAddr(0),
    _lastProgressUs(0),
    _laps(0),
    _txAborts(0),
    _dmaStarts(0), _dmaStops(0), _dmaRestarts(0), _stopWaitMaxUs(0), _wedgeRecoveries(0), _abortTimeouts(0),
    _busPaused(false), _busYields(0), _busYieldMaxUs(0), _lockId(-1), _busPauseStartUs(0), _busForcedResumes(0),
    _dummySrc(0), _dummyDst(0) {
    _repeat_factor = 1;
    _repeat_remaining = 1;
    _plan.ok = false;
    _plan.N = 2; _plan.D = 1; _plan.X = 0; _plan.Y = 1; _plan.tickHz = 0; _plan.actualHz = 0;

    // Initialize calibration arrays
    for (int i = 0; i < 4; i++) {
        _calibration_offset[i] = 0.0f;
        _calibration_gain[i] = 1.0f;
    }
}

/*!
 *    @brief  Destructor - free buffers if allocated
 */
WaveGen::~WaveGen() {
    if (_waveform_table_allocated && _waveform_table != nullptr) {
        delete[] _waveform_table;
        _waveform_table = nullptr;
        _waveform_table_allocated = false;
    }
    if (_imageAllocated && _image != nullptr) {
        delete[] _image;
        _image = nullptr;
        _imageAllocated = false;
    }
}

/*!
 *    @brief  Initialize the waveform generator
 */
bool WaveGen::begin(uint8_t i2c_address, TwoWire *wire) {
    // The API calls begin() on every wavegen_start(); if a stream is live,
    // release the bus first (isRunning() stays true - the bus is still ours),
    // _dac.begin() below talks to the chip, and start() re-arms.
    if (_dmaStreaming) {
        _dmaStop();
    }
    if (!_dac.begin(i2c_address, wire)) {
        return false;
    }

    // Allocate waveform table buffer
    if (!_waveform_table_allocated) {
        _waveform_table = new (std::nothrow) uint16_t[MAX_WAVEFORM_TABLE_SIZE];
        if (_waveform_table == nullptr) {
            Serial.println("WaveGen: Failed to allocate waveform table");
            return false;
        }
        _waveform_table_allocated = true;
        memset((void*)_waveform_table, 0, MAX_WAVEFORM_TABLE_SIZE * sizeof(uint16_t));
    }

    _dmaClaim();   // once; sets _dmaAvailable or a fallback reason

    _initialized = true;
    _updateTableSize();
    _buildWaveformTable();
    _updateSampleInterval();

    return true;
}

/*!
 *    @brief  End the waveform generator
 */
void WaveGen::end() {
    stop();
    _dac.end();
    _initialized = false;

    // Free allocated buffers (the DMA channels/timer stay claimed - begin()
    // is called on every wavegen_start(), and re-claiming would leak them)
    if (_waveform_table_allocated && _waveform_table != nullptr) {
        delete[] _waveform_table;
        _waveform_table = nullptr;
        _waveform_table_allocated = false;
    }
}

/*!
 *    @brief  Set the active channel
 */
void WaveGen::setChannel(waveGen_channel_t channel) {
    _channel = channel;
    _params_changed = true;
    if (_initialized) {
        _buildWaveformTable();
        _dmaRestartIfRunning();
    }
}

/*!
 *    @brief  Set the waveform type
 */
void WaveGen::setWaveform(waveGen_waveform_t waveform) {
    _waveform = waveform;
    _params_changed = true;
    if (_initialized) {
        _buildWaveformTable();
        _dmaRestartIfRunning();
    }
}

/*!
 *    @brief  Set the frequency
 */
void WaveGen::setFrequency(float frequency_hz) {
    _frequency_hz = frequency_hz;
    _params_changed = true;
    if (_initialized) {
        _updateTableSize();
        _buildWaveformTable();
        _updateSampleInterval();
        _dmaRestartIfRunning();
    }
}

/*!
 *    @brief  Set the amplitude
 */
void WaveGen::setAmplitude(float amplitude_v) {
    _amplitude_v = amplitude_v;
    _params_changed = true;
    if (_initialized) {
        _buildWaveformTable();
        _dmaRestartIfRunning();
    }
}

/*!
 *    @brief  Set the offset
 */
void WaveGen::setOffset(float offset_v) {
    _offset_v = offset_v;
    _params_changed = true;
    if (_initialized) {
        _buildWaveformTable();
        _dmaRestartIfRunning();
    }
}

/*!
 *    @brief  Start waveform generation
 */
bool WaveGen::start() {
    if (!_initialized) {
        return false;
    }

    // The bus gate first: from here every other I2C0 user skips.
    _running = true;
    _last_sample_time = micros();
    _sample_count = 0;
    _table_index = 0;
    _use_fallback = false;
    _stats_window_start_us = micros();
    _samples_since_stats = 0;
    _indices_since_stats = 0;
    _repeat_factor = 1;
    _repeat_remaining = _repeat_factor;

    _params_changed = false;

    if (_dmaAvailable) {
        if (_dmaStart()) {
            return true;
        }
        // Could not arm the stream (the bus never went idle, or the planner
        // refused): do NOT stay "running" - that would hold the bus gate with
        // nothing streaming. Loud failure instead.
        _running = false;
        return false;
    }
    _updateTableSize();
    _buildWaveformTable();
    return true;
}

/*!
 *    @brief  Stop waveform generation
 */
void WaveGen::stop() {
    if (_dmaStreaming) {
        _dmaStop();          // with _running still true: the bus is ours until the drain is done
    }
    _running = false;

    // The wave streamed raw MCP4728 codes with globalState.power untouched.
    // If the channel was DAC0 (the default - and the probe feed), the feed's
    // skip-if-parked guard would trust the stale in-window state and leave
    // the buffer at the last sample forever; the bump forces a re-park on
    // the next rebuild.
    extern void infraDacParkEpochBump(void);
    infraDacParkEpochBump();
}

/*!
 *    @brief  Service function - call frequently from main loop (core 1)
 */
void WaveGen::service() {
    if (!_running || !_initialized || _waveform_table == nullptr) {
        return;
    }
    if (_dmaAvailable) {
        _dmaMonitor();
        return;
    }
    _serviceLegacy();
}

// ===========================================================================
// The legacy per-sample loop (fallback only): unchanged.
// ===========================================================================
void WaveGen::_serviceLegacy() {
    // BLOCKING streaming loop for core2: keep the I2C transaction open and
    // write samples continuously. Only exit when stopped or params change.

    // If params changed, rebuild tables and restart streaming
    if (_params_changed) {
        _updateTableSize();
        _buildWaveformTable();
        _updateSampleInterval();
        _params_changed = false;
    }

    uint32_t t0_overall = micros();
    uint32_t samples_sent_this_call = 0;

    // Determine if we should use non-blocking mode (low frequency)
    bool use_nonblocking = (_frequency_hz < WAVEGEN_NONBLOCKING_THRESHOLD_HZ);
    uint32_t samples_to_send = use_nonblocking ? _table_size : UINT32_MAX; // One cycle for low freq, continuous for high freq

    // Per-sample repeated-START streaming to keep bus flow continuous and avoid
    // long buffered drains. Each sample is its own short transaction.

    while (_running && !_params_changed && samples_sent_this_call < samples_to_send) {
        // Would-be watchdog kick from the core-1 stream loop (measure-only
        // stage, KickGap.h): a >= 1 kHz stream holds core 1 here for its whole
        // duration - the site the T1.6 numbers said an enable needs.
        kickGapStamp( 1, KICK_WAVEGEN );
        // Synchronous per-sample write with STOP; simpler and accurate timing
        bool ok = _dac.setChannelValue((MCP4728_channel_t)_channel,
                                       _waveform_table[_table_index]);
        if (!ok) {
            _failed_writes++;
            continue;
        }
        _successful_writes++;

        // Advance to next table entry honoring repeat factor for very low frequencies
        if (_repeat_remaining > 1) {
            _repeat_remaining--;
        } else {
            _repeat_remaining = _repeat_factor;
            _table_index = (_table_index + 1) % _table_size;
            _indices_since_stats++;
        }
        samples_sent_this_call++;
        _samples_since_stats++;
        // Update rolling actual frequency every ~10ms for stability
        uint32_t t_now = micros();
        uint32_t dt = t_now - _stats_window_start_us;
        if (dt >= 10000 && _table_size > 0) { // 10 ms window
            float indices_per_sec = ((float)_indices_since_stats) * (1000000.0f / (float)dt);
            _actual_frequency = indices_per_sec / (float)_table_size;
            _stats_window_start_us = t_now;
            _samples_since_stats = 0;
            _indices_since_stats = 0;
        }
    }

    // Periodic frequency estimate
    uint32_t now = micros();
    (void)t0_overall;
    if (now - _last_stats_time >= 1000000) {
        _updateStatistics();
        _last_stats_time = now;
    }
}

/*!
 *    @brief  Set calibration offset for a channel
 */
void WaveGen::setCalibrationOffset(waveGen_channel_t channel, float offset_v) {
    if ((int)channel < 4) {
        _calibration_offset[channel] = offset_v;
    }
}

/*!
 *    @brief  Set calibration gain for a channel
 */
void WaveGen::setCalibrationGain(waveGen_channel_t channel, float gain) {
    if ((int)channel < 4) {
        _calibration_gain[channel] = gain;
    }
}


//! Bytes per sample calibration for I2C overhead - LEGACY MODEL (CPU loop).
//! This accounts for: address byte + command byte + 2 data bytes + protocol overhead (START/STOP/ACK)
//! Empirically calibrated to match actual frequency output
#define B_PER_SAM 4.67f

/*!
 *    @brief  Get the actual achievable frequency for a desired frequency
 */
float WaveGen::getAchievableFrequency(float desired_freq) const {
    if (_dmaAvailable) {
        DmaPlan p = _planRate(desired_freq);
        return p.ok ? p.actualHz : desired_freq;
    }
    // Legacy model: synchronous-per-sample, 3 bytes per write
    float i2c_hz = 1000000.0f;
    const float BYTES_PER_SAMPLE = B_PER_SAM;
    float effective_samples_per_sec = (i2c_hz / 9.0f) / BYTES_PER_SAMPLE;
    if (effective_samples_per_sec < 1.0f) effective_samples_per_sec = 1.0f;

    float calculated_size = effective_samples_per_sec / desired_freq;
    size_t table_size = (size_t)(calculated_size + 0.5f);
    if (table_size < 2) {
        table_size = 2;
    } else if (table_size > MAX_WAVEFORM_TABLE_SIZE) {
        table_size = MAX_WAVEFORM_TABLE_SIZE;
    }
    float achievable_no_repeat = effective_samples_per_sec / (float)table_size;
    if (desired_freq < achievable_no_repeat) {
        float repeat = achievable_no_repeat / desired_freq;
        if (repeat < 1.0f) repeat = 1.0f;
        float predicted = achievable_no_repeat / (float)((uint32_t)(repeat + 0.5f));
        return predicted;
    }
    return achievable_no_repeat;
}

/*!
 *    @brief  Set frequency and return the actual achievable frequency
 */
float WaveGen::setFrequencyAdjusted(float frequency_hz) {
    setFrequency(frequency_hz);
    if (_dmaAvailable) {
        return _plan.ok ? _plan.actualHz : getAchievableFrequency(frequency_hz);
    }
    float i2c_hz = 1000000.0f;
    const float BYTES_PER_SAMPLE = B_PER_SAM;
    float effective_samples_per_sec = (i2c_hz / 9.0f) / BYTES_PER_SAMPLE;
    if (effective_samples_per_sec < 1.0f) effective_samples_per_sec = 1.0f;
    size_t ts = _table_size > 0 ? _table_size : 1;
    uint32_t rf = _repeat_factor > 0 ? _repeat_factor : 1;
    float predicted = effective_samples_per_sec / ((float)ts * (float)rf);
    return predicted;
}

/*!
 *    @brief  Update table size based on frequency for accurate frequency generation
 */
void WaveGen::_updateTableSize() {
    if (_dmaAvailable) {
        // DMA path: N comes from the planner (a power of two the bus can
        // carry at this frequency); the divider replaces the repeat factor.
        DmaPlan p = _planRate(_frequency_hz);
        _table_size = p.ok ? p.N : 2;
        _repeat_factor = 1;
        _repeat_remaining = 1;
        _plan = p;
        return;
    }
    // Legacy model: effective sample rate based on I2C clock and bytes per sample
    float i2c_hz = 1000000.0f;
    const float BYTES_PER_SAMPLE = B_PER_SAM;
    float effective_samples_per_sec = (i2c_hz / 9.0f) / BYTES_PER_SAMPLE;
    if (effective_samples_per_sec < 1.0f) effective_samples_per_sec = 1.0f;

    float calculated_size = effective_samples_per_sec / _frequency_hz;
    _table_size = (size_t)(calculated_size + 0.5f);
    if (_table_size < 2) {
        _table_size = 2;
    } else if (_table_size > MAX_WAVEFORM_TABLE_SIZE) {
        _table_size = MAX_WAVEFORM_TABLE_SIZE;
    }

    _repeat_factor = 1;
    if (_table_size > 0) {
        float achievable_freq = effective_samples_per_sec / (float)_table_size;
        if (_frequency_hz < achievable_freq) {
            float required_sps = _frequency_hz * (float)_table_size; // samples/sec needed
            if (required_sps < 1.0f) required_sps = 1.0f;
            float repeat = (effective_samples_per_sec / required_sps);
            if (repeat < 1.0f) repeat = 1.0f;
            if (repeat > 1.0f) {
                if (repeat > 1000000.0f) repeat = 1000000.0f;
                _repeat_factor = (uint32_t)(repeat + 0.5f);
                if (_repeat_factor == 0) _repeat_factor = 1;
            }
        }
    }
    _repeat_remaining = _repeat_factor;
}

/*!
 *    @brief  Build the waveform lookup table
 */
void WaveGen::_buildWaveformTable() {
    if (_waveform_table == nullptr) {
        return;  // Buffer not allocated yet
    }

    for (size_t i = 0; i < _table_size; i++) {
        float t = (float)i / (float)_table_size; // 0..1
        float value = 0.0f;

        switch (_waveform) {
            case WAVEGEN_SINE: {
                value = sinf(2.0f * M_PI * t);
                break;
            }
            case WAVEGEN_TRIANGLE: {
                value = 4.0f * fabsf(t - floorf(t + 0.5f)) - 1.0f; // -1..1
                break;
            }
            case WAVEGEN_SAWTOOTH: {
                value = 2.0f * (t - floorf(t + 0.5f)); // -1..1
                break;
            }
            case WAVEGEN_SQUARE: {
                value = (t < 0.5f) ? 1.0f : -1.0f;
                break;
            }
        }

        // Apply amplitude and offset
        float voltage = _offset_v + _amplitude_v * value;

        // Convert to DAC code
        _waveform_table[i] = _voltsToCode(voltage, _channel);
    }
}

/*!
 *    @brief  Convert voltage to DAC code using proper ±8V scaling and calibration
 */
uint16_t WaveGen::_voltsToCode(float voltage, waveGen_channel_t channel) {
    // Apply calibration
    voltage = voltage * _calibration_gain[channel] + _calibration_offset[channel];

    // Clamp to valid range (±8V)
    voltage = constrain(voltage, -8.0f, 8.0f);

    // Use the same calibration system as Peripherals.cpp
    // dacSpread[channel] is the voltage range, dacZero[channel] is the zero point
    extern float dacSpread[4];
    extern int dacZero[4];

    // Convert voltage to DAC code using calibration values
    int code = (int)(voltage * 4095.0f / dacSpread[channel]) + dacZero[channel];

    return constrain(code, 0, 4095);
}

/*!
 *    @brief  Update the sample interval (legacy; kept for compatibility)
 */
void WaveGen::_updateSampleInterval() {
    _sample_interval_us = 1; // not used with per-sample streaming; maintained for compatibility
}

/*!
 *    @brief  Update statistics (legacy loop)
 */
void WaveGen::_updateStatistics() {
    if (_table_size > 0) {
        uint32_t dt = micros() - _stats_window_start_us;
        if (dt > 0) {
            float indices_per_sec = ((float)_indices_since_stats) * (1000000.0f / (float)dt);
            _actual_frequency = indices_per_sec / (float)_table_size;
        }
        _stats_window_start_us = micros();
        _samples_since_stats = 0;
        _indices_since_stats = 0;
    }
}

// ===========================================================================
// T3.3: the DMA stream
// ===========================================================================

// Best rational X/Y <= maxQ for x in (0, 1] (continued fractions, with the
// last semiconvergent that still fits): the pacing timer runs at
// clk_sys * X / Y, so this is the tick's precision.
static void wgBestFraction(double x, uint32_t maxQ, uint16_t* numOut, uint16_t* denOut) {
    if (x >= 1.0) { *numOut = 1; *denOut = 1; return; }
    if (x <= 0.0) { *numOut = 0; *denOut = 1; return; }
    uint32_t bestP = 1, bestQ = (uint32_t)maxQ;
    double bestErr = fabs(x - (double)bestP / (double)bestQ);
    auto consider = [&](uint32_t p, uint32_t q) {
        if (q == 0 || q > maxQ || p == 0 || p > maxQ) return;
        double e = fabs(x - (double)p / (double)q);
        if (e < bestErr) { bestErr = e; bestP = p; bestQ = q; }
    };
    uint32_t p0 = 0, q0 = 1, p1 = 1, q1 = 0;
    double v = x;
    for (int i = 0; i < 40; i++) {
        double af = floor(v);
        if (af > 4.0e9) break;
        uint32_t a = (uint32_t)af;
        // overflow-safe next convergent
        uint64_t p2 = (uint64_t)a * p1 + p0;
        uint64_t q2 = (uint64_t)a * q1 + q0;
        if (q2 > maxQ) {
            // the largest semiconvergent that still fits
            if (q1 > 0) {
                uint32_t k = (maxQ - q0) / q1;
                if (k >= 1) consider(p0 + k * p1, q0 + k * q1);
            }
            break;
        }
        consider((uint32_t)p2, (uint32_t)q2);
        p0 = p1; q0 = q1; p1 = (uint32_t)p2; q1 = (uint32_t)q2;
        double frac = v - af;
        if (frac < 1e-15) break;
        v = 1.0 / frac;
        if (bestErr == 0.0) break;
    }
    *numOut = (uint16_t)bestP;
    *denOut = (uint16_t)bestQ;
}

// Samples per second the I2C0 bus carries: SCL rate from the block's own
// counts (what Wire programmed - 1 MHz since T1.9), 40 bit-times per sample.
float WaveGen::_busCapacityHz() const {
    i2c_hw_t* hw = i2c0_hw;
    uint32_t speed = (hw->con >> 1) & 0x3;   // IC_CON.SPEED: 1 = standard, 2 = fast, 3 = high
    uint32_t hcnt = (speed == 1) ? hw->ss_scl_hcnt : hw->fs_scl_hcnt;
    uint32_t lcnt = (speed == 1) ? hw->ss_scl_lcnt : hw->fs_scl_lcnt;
    uint32_t period = hcnt + lcnt + 8;       // + spike filter / edge margins
    if (period < 20) period = 20;
    float scl = (float)clock_get_hz(clk_sys) / (float)period;
    if (scl > 3.4e6f) scl = 3.4e6f;
    if (scl < 50000.0f) scl = 50000.0f;
    return scl / WG_BITS_PER_SAMPLE;
}

WaveGen::DmaPlan WaveGen::_planRate(float frequency_hz) const {
    DmaPlan p;
    p.ok = false; p.N = 2; p.D = 1; p.X = 0; p.Y = 1; p.tickHz = 0; p.actualHz = 0;
    double f = (double)frequency_hz;
    if (!(f > 0.0)) f = 0.0001;
    double cap = (double)_busCapacityHz();
    double tickMax = cap * WG_CAPACITY_MARGIN;
    if (tickMax < 10.0) return p;

    // N: the largest power of two whose sample rate the bus can carry.
    uint32_t N = 2;
    while ((N * 2) <= MAX_WAVEFORM_TABLE_SIZE && f * (double)(N * 2) <= tickMax) N *= 2;
    double tick = f * (double)N;
    if (tick > tickMax) tick = tickMax;   // f above the bus's reach at N = 2: run at capacity, report the truth

    // D and X/Y: the timer must run above its floor; the divider brings the
    // effective tick down. Try a few dividers and keep the closest.
    double clk = (double)clock_get_hz(clk_sys);
    uint32_t D0 = 1;
    if (tick < WG_TICK_T_MIN_HZ) D0 = (uint32_t)ceil(WG_TICK_T_MIN_HZ / tick);
    if (D0 < 1) D0 = 1;
    double bestErr = 1e9;
    for (uint32_t D = D0; D < D0 + 16 && D < (1u << 27); D++) {
        double tt = tick * (double)D;
        if (tt > clk) break;
        double ratio = tt / clk;
        uint16_t X, Y;
        wgBestFraction(ratio, 65535, &X, &Y);
        if (X == 0) continue;
        double act = clk * (double)X / (double)Y / (double)D;
        double err = fabs(act - tick) / tick;
        if (err < bestErr) {
            bestErr = err;
            p.N = N; p.D = D; p.X = X; p.Y = Y;
            p.tickHz = (float)act;
            p.actualHz = (float)(act / (double)N);
            p.ok = true;
        }
        if (bestErr < 1e-9) break;
    }
    return p;
}

void WaveGen::_dmaClaim() {
    if (_dmaAvailable) return;
    _dmaFallbackReason = 0;
#if defined(OG_JUMPERLESS)
    // No OG board attached to verify the stream on an RP2040 (its DMA and
    // I2C blocks would do it); the OG keeps the legacy loop, as with T2.3.
    _dmaFallbackReason = 5;
    return;
#endif
    if (_dac.getWire() != &Wire) { _dmaFallbackReason = 1; return; }   // the image is I2C0's
    if (!_imageAllocated) {
        _image = new (std::nothrow) uint16_t[MAX_WAVEFORM_TABLE_SIZE * 3];
        if (_image == nullptr) { _dmaFallbackReason = 4; return; }
        _imageAllocated = true;
    }
    int a = dma_claim_unused_channel(false);
    int b1 = (a >= 0) ? dma_claim_unused_channel(false) : -1;
    int b2 = (b1 >= 0) ? dma_claim_unused_channel(false) : -1;
    if (a < 0 || b1 < 0 || b2 < 0) {
        if (a >= 0) dma_channel_unclaim((uint)a);
        if (b1 >= 0) dma_channel_unclaim((uint)b1);
        if (b2 >= 0) dma_channel_unclaim((uint)b2);
        _dmaFallbackReason = 2;
        return;
    }
    int t = dma_claim_unused_timer(false);
    if (t < 0) {
        dma_channel_unclaim((uint)a); dma_channel_unclaim((uint)b1); dma_channel_unclaim((uint)b2);
        _dmaFallbackReason = 3;
        return;
    }
    dma_timer_set_fraction((uint)t, 0, 1);   // idle: no ticks
    if (_lockId < 0) {
        int id = spin_lock_claim_unused(false);
        if (id >= 0) { spin_lock_init((uint)id); _lockId = id; }
    }
    _chA = a; _chB1 = b1; _chB2 = b2; _dmaTimer = t;
    _dmaAvailable = true;
}

// Pause the stream at a sample boundary and leave the bus idle: pacing
// timer to 0 (B1 parks; a credit already granted may fire ONE more burst
// within a microsecond, so give it that), then wait for A to be idle and
// the block to have clocked everything out. Bounded; true = idle now.
bool WaveGen::_drainForForeign(uint32_t budgetUs) {
    i2c_hw_t* hw = i2c0_hw;
    dma_timer_set_fraction((uint)_dmaTimer, 0, 1);
    uint32_t t0 = time_us_32();
    while ((time_us_32() - t0) < 3) { tight_loop_contents(); }
    for (;;) {
        bool aIdle = !dma_channel_is_busy((uint)_chA);
        bool busIdle = (hw->status & I2C_IC_STATUS_TFE_BITS) && !(hw->status & I2C_IC_STATUS_MST_ACTIVITY_BITS);
        if (aIdle && busIdle) {
            // once more, a few cycles later, so a burst that started between
            // the two reads is caught
            uint32_t t1 = time_us_32();
            while ((time_us_32() - t1) < 2) { tight_loop_contents(); }
            if (!dma_channel_is_busy((uint)_chA) &&
                (hw->status & I2C_IC_STATUS_TFE_BITS) && !(hw->status & I2C_IC_STATUS_MST_ACTIVITY_BITS)) return true;
        }
        if ((time_us_32() - t0) > budgetUs) return false;
        tight_loop_contents();
    }
}

bool WaveGen::busPause() {
    if (!_dmaStreaming || _lockId < 0) return false;
    spin_lock_t* lk = spin_lock_instance((uint)_lockId);
    uint32_t save = spin_lock_blocking(lk);
    if (!_dmaStreaming || _busPaused) { spin_unlock(lk, save); return false; }
    uint32_t t0 = time_us_32();
    bool idle = _drainForForeign(3000);
    _busPaused = true;
    _busPauseStartUs = time_us_32();
    _busYields++;
    uint32_t dt = time_us_32() - t0;
    if (dt > _busYieldMaxUs) _busYieldMaxUs = dt;
    if (!idle) _wedgeRecoveries++;   // the bus did not drain: the foreign transaction proceeds anyway (Wire has its own timeout)
    spin_unlock(lk, save);
    return true;
}

void WaveGen::busResume() {
    if (_lockId < 0) return;
    spin_lock_t* lk = spin_lock_instance((uint)_lockId);
    uint32_t save = spin_lock_blocking(lk);
    if (_busPaused) {
        _busPaused = false;
        if (_dmaStreaming) {
            // Wire may have left the block's target on the device it talked
            // to; the DAC is ours again.
            i2c_hw_t* hw = i2c0_hw;
            if ((hw->tar & 0x3FF) != _dac.getAddress()) {
                hw->enable = 0;
                hw->tar = _dac.getAddress();
                hw->enable = 1;
            }
            hw->dma_tdlr = 8;
            hw->dma_cr = I2C_IC_DMA_CR_TDMAE_BITS;
            (void)hw->clr_tx_abrt;
            dma_timer_set_fraction((uint)_dmaTimer, _plan.X, _plan.Y);
        }
    }
    spin_unlock(lk, save);
}

// The wraps' entry points (I2C0Arbiter.cpp); the global lives in main.cpp.
extern WaveGen wavegen;
extern "C" bool wavegenBusPause(void) { return wavegen.busPause(); }
extern "C" void wavegenBusResume(void) { wavegen.busResume(); }

void WaveGen::_dmaBuildImage() {
    uint32_t N = _plan.N;
    uint8_t cmd = (uint8_t)(0x40 | (((uint8_t)_channel) << 1));   // MULTI_IR write, UDAC = 0: immediate
    for (uint32_t i = 0; i < N; i++) {
        uint16_t v = _waveform_table[i] & 0x0FFF;   // VREF_VDD, PD normal, GAIN_1X: top nibble 0 (setChannelValue's defaults)
        _image[3 * i + 0] = cmd;
        _image[3 * i + 1] = (uint16_t)(v >> 8);
        _image[3 * i + 2] = (uint16_t)((v & 0xFF) | WG_DC_STOP);
        s_addrRing[i] = (uint32_t)&_image[3 * i];
    }
}

static inline uint32_t wgLog2(uint32_t v) { uint32_t r = 0; while ((1u << (r + 1)) <= v) r++; return r; }

// Abort a set of channels the way the datasheet says (12.6.8.3, RP2350-E5):
// clear EN and CHAIN_TO on all of them first (so a chain cannot re-trigger
// one while another is being aborted - B1 and B2 trigger each other), then
// one CHAN_ABORT write for the whole set, then poll. Every wait is bounded:
// this runs on core 0 inside an API call, and the SDK's dma_channel_abort()
// spins unbounded on BUSY - which is exactly where a channel parked on a
// pacing timer that has just been stopped can leave it. Returns false if a
// channel would not go quiet in time (counted by the caller).
static bool wgAbortChannels(uint32_t mask) {
    for (uint ch = 0; ch < NUM_DMA_CHANNELS; ch++) {
        if (!(mask & (1u << ch))) continue;
        hw_write_masked(&dma_hw->ch[ch].al1_ctrl,
                        (ch << DMA_CH0_CTRL_TRIG_CHAIN_TO_LSB) | (0u << DMA_CH0_CTRL_TRIG_EN_LSB),
                        DMA_CH0_CTRL_TRIG_CHAIN_TO_BITS | DMA_CH0_CTRL_TRIG_EN_BITS);
    }
    dma_hw->abort = mask;
    uint32_t t0 = time_us_32();
    while ((dma_hw->abort & mask) && (time_us_32() - t0) < 2000) { tight_loop_contents(); }
    bool ok = (dma_hw->abort & mask) == 0;
    for (uint ch = 0; ch < NUM_DMA_CHANNELS; ch++) {
        if (!(mask & (1u << ch))) continue;
        uint32_t t1 = time_us_32();
        while ((dma_hw->ch[ch].ctrl_trig & DMA_CH0_CTRL_TRIG_BUSY_BITS) && (time_us_32() - t1) < 2000) { tight_loop_contents(); }
        if (dma_hw->ch[ch].ctrl_trig & DMA_CH0_CTRL_TRIG_BUSY_BITS) ok = false;
    }
    return ok;
}

bool WaveGen::_dmaStart() {
    if (!_dmaAvailable || !_initialized || _waveform_table == nullptr) return false;
    if (_dmaStreaming) return true;

    DmaPlan p = _planRate(_frequency_hz);
    if (!p.ok) return false;
    _plan = p;
    _table_size = p.N;
    _buildWaveformTable();
    _dmaBuildImage();

    i2c_hw_t* hw = i2c0_hw;
    // The bus must be idle. Wire's transactions are blocking and every user
    // is core 0 (this core), so it is - bounded wait anyway.
    uint32_t t0 = time_us_32();
    while ((hw->status & I2C_IC_STATUS_ACTIVITY_BITS) && (time_us_32() - t0) < 3000) { tight_loop_contents(); }
    if (hw->status & I2C_IC_STATUS_ACTIVITY_BITS) return false;

    // Target = the DAC (TAR can only change while the block is disabled -
    // Wire does the same dance per transaction, and re-does it on its next).
    hw->enable = 0;
    hw->tar = _dac.getAddress();
    hw->enable = 1;
    (void)hw->clr_tx_abrt;
    hw->dma_tdlr = 8;                                   // DREQ while <= 8 of 16 entries queued
    hw->dma_cr = I2C_IC_DMA_CR_TDMAE_BITS;

    // A: image -> TX FIFO, 3 entries per trigger, paced by the FIFO
    dma_channel_config ca = dma_channel_get_default_config((uint)_chA);
    channel_config_set_transfer_data_size(&ca, DMA_SIZE_16);
    channel_config_set_read_increment(&ca, true);
    channel_config_set_write_increment(&ca, false);
    channel_config_set_dreq(&ca, i2c_get_dreq(i2c0, true));
    dma_channel_configure((uint)_chA, &ca, &hw->data_cmd, _image, 3, false);

    // B2: address ring -> A's READ_ADDR_TRIG (one write = one sample), then B1
    dma_channel_config cb2 = dma_channel_get_default_config((uint)_chB2);
    channel_config_set_transfer_data_size(&cb2, DMA_SIZE_32);
    channel_config_set_read_increment(&cb2, true);
    channel_config_set_write_increment(&cb2, false);
    channel_config_set_ring(&cb2, false, wgLog2(4u * p.N));
    channel_config_set_chain_to(&cb2, (uint)_chB1);
    dma_channel_configure((uint)_chB2, &cb2, &dma_hw->ch[_chA].al3_read_addr_trig, s_addrRing, 1, false);

    // B1: the divider - D timer ticks per pass, then B2
    dma_channel_config cb1 = dma_channel_get_default_config((uint)_chB1);
    channel_config_set_transfer_data_size(&cb1, DMA_SIZE_32);
    channel_config_set_read_increment(&cb1, false);
    channel_config_set_write_increment(&cb1, false);
    channel_config_set_dreq(&cb1, dma_get_timer_dreq((uint)_dmaTimer));
    channel_config_set_chain_to(&cb1, (uint)_chB2);
    dma_channel_configure((uint)_chB1, &cb1, &_dummyDst, &_dummySrc, p.D, false);

    _lastRingAddr = (uint32_t)s_addrRing;
    _lastProgressUs = time_us_32();
    _dmaWedged = false;
    _laps = 0;
    _actual_frequency = p.actualHz;
    __dmb();
    dma_channel_start((uint)_chB1);                      // armed, no ticks yet
    dma_timer_set_fraction((uint)_dmaTimer, p.X, p.Y);  // pacing begins
    _dmaStreaming = true;
    _dmaStarts++;
    return true;
}

void WaveGen::_dmaStop() {
    if (!_dmaStreaming) return;
    i2c_hw_t* hw = i2c0_hw;
    uint32_t t0 = time_us_32();
    spin_lock_t* lk = (_lockId >= 0) ? spin_lock_instance((uint)_lockId) : nullptr;
    uint32_t save = lk ? spin_lock_blocking(lk) : 0;

    // 1. Take the pacing pair down: EN + chain off on both, one abort for
    //    both, then the timer to 0. (Not the timer first: a channel parked on
    //    a stopped DREQ is the case the abort spins on - see wgAbortChannels.)
    if (!wgAbortChannels((1u << _chB1) | (1u << _chB2))) _abortTimeouts++;
    dma_timer_set_fraction((uint)_dmaTimer, 0, 1);

    // 2. A only ever pushes whole 3-entry bursts: let the in-flight one finish
    //    (microseconds), so the FIFO ends on a STOP entry.
    uint32_t tA = time_us_32();
    while (dma_channel_is_busy((uint)_chA) && (time_us_32() - tA) < 2000) { tight_loop_contents(); }
    if (dma_channel_is_busy((uint)_chA)) {
        // Wedged: the FIFO is full and not draining (bus stuck). Abort A and
        // complete the sample by hand so the transaction still ends with a
        // STOP - then the block's own abort if even that does not drain.
        uint32_t remaining = dma_channel_hw_addr((uint)_chA)->transfer_count & 0x0FFFFFFFu;
        uint32_t next = dma_channel_hw_addr((uint)_chA)->read_addr;
        if (!wgAbortChannels(1u << _chA)) _abortTimeouts++;
        _wedgeRecoveries++;
        if (remaining > 0 && remaining < 3) {
            const uint16_t* e = (const uint16_t*)next;
            for (uint32_t i = 0; i < remaining; i++) {
                uint32_t tw = time_us_32();
                while (!(hw->status & I2C_IC_STATUS_TFNF_BITS) && (time_us_32() - tw) < 1000) { tight_loop_contents(); }
                if (hw->status & I2C_IC_STATUS_TFNF_BITS) hw->data_cmd = e[i];
            }
        }
    }

    // 3. Drain: FIFO empty and the controller idle.
    uint32_t tD = time_us_32();
    while ((!(hw->status & I2C_IC_STATUS_TFE_BITS) || (hw->status & I2C_IC_STATUS_MST_ACTIVITY_BITS)) &&
           (time_us_32() - tD) < 5000) { tight_loop_contents(); }
    if (!(hw->status & I2C_IC_STATUS_TFE_BITS) || (hw->status & I2C_IC_STATUS_MST_ACTIVITY_BITS)) {
        // The block's own abort: issues a STOP and flushes the TX FIFO.
        hw->enable |= I2C_IC_ENABLE_ABORT_BITS;
        uint32_t tb = time_us_32();
        while ((hw->enable & I2C_IC_ENABLE_ABORT_BITS) && (time_us_32() - tb) < 2000) { tight_loop_contents(); }
        _wedgeRecoveries++;
    }
    hw->dma_cr = 0;
    (void)hw->clr_tx_abrt;

    // The MCP4728 shadow no longer knows this channel's register.
    MCP4728::invalidateCache((int)_channel);

    uint32_t dt = time_us_32() - t0;
    if (dt > _stopWaitMaxUs) _stopWaitMaxUs = dt;
    _dmaStreaming = false;
    _busPaused = false;
    _dmaStops++;
    if (lk) spin_unlock(lk, save);
}

void WaveGen::_dmaRestartIfRunning() {
    if (!_dmaAvailable || !_running) return;
    // isRunning() stays true throughout: the bus gates hold.
    if (_dmaStreaming) _dmaStop();
    _dmaRestarts++;
    _dmaStart();
}

// Core 1, every core2stuff pass while running: progress / wedge / TX_ABRT.
extern "C" void i2c0ArbiterForceRelease(void);
void WaveGen::_dmaMonitor() {
    if (!_dmaStreaming) return;
    uint32_t now = time_us_32();
    // A pause the arbiter held for a repeated-START pair whose second half
    // never came (a Wire error path): release it - the stream must not stay
    // paused forever.
    if (_busPaused && (now - _busPauseStartUs) > 100000) {
        i2c0ArbiterForceRelease();
        busResume();
        _busForcedResumes++;
    }
    uint32_t ra = dma_hw->ch[_chB2].read_addr;
    if (ra != _lastRingAddr) {
        if (ra < _lastRingAddr) {   // the ring wrapped: one full cycle
            _laps++;
            _successful_writes += _plan.N;
        }
        _lastRingAddr = ra;
        _lastProgressUs = now;
    } else if (!_dmaWedged && !_busPaused) {
        // Expected time between samples; "no progress" is only a wedge if
        // several samples should have gone by (a 0.0001 Hz wave at N = 2
        // legitimately sits still for 5000 s).
        float period_us = (_plan.tickHz > 0.0f) ? (1.0e6f / _plan.tickHz) : 1.0e6f;
        uint32_t limit = (uint32_t)(period_us * 4.0f);
        if (limit < 200000) limit = 200000;
        if (limit > 4000000000u) limit = 4000000000u;
        if ((now - _lastProgressUs) > limit) {
            _dmaWedged = true;
            dma_timer_set_fraction((uint)_dmaTimer, 0, 1);   // stop feeding a stuck bus; stop() recovers
        }
    }
    // A NAK (or any abort) flushes the TX FIFO and holds it until cleared;
    // clear it here so the stream heals, count it as failed samples.
    if (i2c0_hw->raw_intr_stat & I2C_IC_RAW_INTR_STAT_TX_ABRT_BITS) {
        _txAborts++;
        _failed_writes++;
        (void)i2c0_hw->clr_tx_abrt;
    }
}

void WaveGen::getDmaStatus(WaveGenDmaStatus* out) const {
    if (out == nullptr) return;
    out->dmaAvailable = _dmaAvailable;
    out->fallbackReason = _dmaFallbackReason;
    out->streaming = _dmaStreaming;
    out->wedged = _dmaWedged;
    out->tableSize = _plan.N;
    out->divider = _plan.D;
    out->timerX = _plan.X;
    out->timerY = _plan.Y;
    out->tickHz = _plan.tickHz;
    out->actualHz = _plan.actualHz;
    out->capacityHz = _busCapacityHz();
    out->laps = _laps;
    out->txAborts = _txAborts;
    out->starts = _dmaStarts;
    out->stops = _dmaStops;
    out->restarts = _dmaRestarts;
    out->stopWaitMaxUs = _stopWaitMaxUs;
    out->wedgeRecoveries = _wedgeRecoveries;
    out->abortTimeouts = _abortTimeouts;
    out->busYields = _busYields;
    out->busYieldMaxUs = _busYieldMaxUs;
    out->busForcedResumes = _busForcedResumes;
}
